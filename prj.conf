## CMakeLists.txt
```
cmake_minimum_required(VERSION 3.20.0)

find_package(Zephyr REQUIRED HINTS $ENV{ZEPHYR_BASE})

project(acf_i2c)

target_sources(app PRIVATE
    src/main.c
    src/fram.c
    src/bh1750.c
    src/i2C_listener.c
    src/i2C_test_listener.c
)

target_include_directories(app PRIVATE
    ${CMAKE_CURRENT_SOURCE_DIR}/Open1722/include
    ${CMAKE_CURRENT_SOURCE_DIR}/src
)
```

## prj.conf
```kconfig
CONFIG_SERIAL=y
CONFIG_CONSOLE=y
CONFIG_UART_CONSOLE=y
CONFIG_PRINTK=y

CONFIG_I2C=y
```

## src/main.c
```c
/*
 * author: biroeser
 * date: 02.10.2026
 * task: Send and Receive data via I2C to/from FRAM.
 */

#include <zephyr/device.h>
#include <zephyr/drivers/i2c.h>
#include <zephyr/kernel.h>
#include <zephyr/sys/printk.h>
#include <stdint.h>
#include "../Open1722/include/avtp/acf/I2C.h"
#include "../Open1722/include/avtp/acf/I2CBrief.h"
#include "bh1750.h"
#include "fram.h"
#include "i2C_test_listener.h"
#include "i2C_listener.h"
#include <zephyr/net/net_if.h>
#include <zephyr/net/net_ip.h>
#include <errno.h>
#include <zephyr/net/ethernet.h>
#include <zephyr/net/net_pkt.h>
#include <zephyr/net/net_core.h>


#define I2C_NODE DT_NODELABEL(i2c1)
// FRAM device parameters
#define FRAM_ADDR 0x50 //7-Bit I2C address of the FRAM device
#define FRAM_TEST_ADDR 0x0000 // Address in FRAM to write and read data
#define TEST_VALUE 0xA5
//BH1750 device parameters
#define BH1750_ADDR       0x23 // connect the ADDR pin to GND for 0x23 or VCC for 0x5C
#define BH1750_ONETIME_HR 0x20 // after one measurement, the device goes to low-power sleep state (it does not measure continuously), high-resolution: The sensor uses a more precise measurement mode, with a typical resolution of 1 lux.


int main(void)
{
    const struct device *i2c_dev = DEVICE_DT_GET(I2C_NODE);
    int ret;
     uint32_t lux_x100;

     /* 1. Check that the I2C controller is ready. */
    if (!device_is_ready(i2c_dev)) {
        printk("FAIL: I2C controller is not ready.\n");
        return 0;
    }
    printk("I2C controller is ready.\n");

     /* 2. Read the BH1750 light measurement. */
    ret = bh1750_read_lux(i2c_dev, &lux_x100);

    if (ret != 0) {
        printk("ERROR: BH1750 measurement failed: %d\n", ret);
        return 0;
    }

     printk("Measured light: %u.%02u lux\n",
        (unsigned int)(lux_x100 / 100),
        (unsigned int)(lux_x100 % 100));


     /* 3. Convert the measurement into four bytes. */
        uint8_t fram_data[4] = {
        (uint8_t)(lux_x100 >> 24),
        (uint8_t)(lux_x100 >> 16),
        (uint8_t)(lux_x100 >> 8),
        (uint8_t)lux_x100
    };


    /* 4. Store the measurement in FRAM. */
    ret = write_to_fram(
        i2c_dev,
        FRAM_TEST_ADDR,
        fram_data,
        sizeof(fram_data)
    );

    if (ret != 0) {
        printk("ERROR: FRAM write failed: %d\n", ret);
        return 0;
    }

    printk("Measurement successfully stored in FRAM.\n");


    /* 5. Read the measurement back from FRAM. */
    uint8_t read_data[4];

    ret = read_fram(
        i2c_dev,
        FRAM_TEST_ADDR,
        read_data,
        sizeof(read_data)
    );

    if (ret != 0) {
        printk("ERROR: FRAM read failed: %d\n", ret);
        return 0;
    }

    /* 6. Reconstruct the 32-bit value from the four bytes */
    lux_x100 =
        ((uint32_t)read_data[0] << 24) |
        ((uint32_t)read_data[1] << 16) |
        ((uint32_t)read_data[2] << 8)  |
        (uint32_t)read_data[3];

    /* Convert lux * 100 back into lux */
    uint32_t lux_whole = lux_x100 / 100;
    uint32_t lux_decimal = lux_x100 % 100;
    printk("Light measurement from FRAM: %u.%02u lux\n",
        (unsigned int)lux_whole,
        (unsigned int)lux_decimal);


     ///7. create an ACF-I2C message and check if it is valid
    printk("\nStarting ACF-I2C tests...\n");

    /* Test Full and Brief message creation and decoding. */
    test_full_i2c_message();
    test_brief_i2c_message();

    /* Test the listener with generated and raw messages. */
    // test_raw_brief_message(i2c_dev);
    // test_full_listener(i2c_dev);
    // test_brief_listener(i2c_dev);

    test_full_fram_write(i2c_dev);
    test_full_fram_read(i2c_dev);
    test_full_fram_multibyte_read(i2c_dev);

    test_brief_fram_write(i2c_dev);
    test_brief_fram_read(i2c_dev);

    test_full_bh1750_read(i2c_dev);

    printk("\nACF-I2C tests completed.\n");

    return 0;
}
```

## src/bh1750.c
```c
#include "bh1750.h"

#include <zephyr/drivers/i2c.h>
#include <zephyr/kernel.h>
#include <errno.h>

/*
 * Perform one high-resolution light measurement.
 */
int bh1750_read_lux(
    const struct device *i2c_dev,
    uint32_t *lux_x100)
{
    if (i2c_dev == NULL || lux_x100 == NULL) {
        return -EINVAL;
    }

    uint8_t command = BH1750_ONETIME_HR;
    uint8_t data[2];

    // 1. Start the measurement.
    int ret = i2c_write(
        i2c_dev,
        &command,
        sizeof(command),
        BH1750_I2C_ADDR
    );

    if (ret != 0) {
        return ret;
    }

    // 2. Wait for the measurement to finish.
    k_msleep(180);

    // 3. Read the two measurement bytes.
    ret = i2c_read(
        i2c_dev,
        data,
        sizeof(data),
        BH1750_I2C_ADDR
    );

    if (ret != 0) {
        return ret;
    }

    // 4. Combine the two bytes into one 16-bit value.
    uint16_t raw = ((uint16_t)data[0] << 8) | data[1];

    // 5. Convert raw measurement to hundredths of lux.
    // BH1750 conversion: lux = raw / 1.2
    *lux_x100 = ((uint32_t)raw * 250U + 1U) / 3U;

    return 0;
}

int bh1750_read_raw(
    const struct device *i2c_dev,
    uint16_t *raw_value)
{
    if (i2c_dev == NULL || raw_value == NULL) {
        return -EINVAL;
    }

    uint8_t command = BH1750_ONETIME_HR;
    uint8_t data[2];

    int ret = i2c_write(
        i2c_dev,
        &command,
        sizeof(command),
        BH1750_I2C_ADDR
    );

    if (ret != 0) {
        return ret;
    }

    k_msleep(180);

    ret = i2c_read(
        i2c_dev,
        data,
        sizeof(data),
        BH1750_I2C_ADDR
    );

    if (ret != 0) {
        return ret;
    }

    *raw_value =
        ((uint16_t)data[0] << 8) | data[1];

    return 0;
}
```

## src/bh1750.h
```c
#ifndef BH1750_H
#define BH1750_H

#include <zephyr/device.h>
#include <stdint.h>

#define BH1750_I2C_ADDR       0x23
#define BH1750_ONETIME_HR     0x20

/*
 * Perform one light measurement.
 *
 * i2c_dev: I2C controller
 * lux_x100: output value in hundredths of lux
 *
 * Example:
 * 12545 means 125.45 lux.
 *
 * Returns 0 on success, negative error code on failure.
 */
int bh1750_read_lux(
    const struct device *i2c_dev,
    uint32_t *lux_x100
);

#endif
```

## src/fram.c
```c
#include "fram.h"

#include <zephyr/drivers/i2c.h>
#include <errno.h>
#include <string.h>

/*
 * Write data to the FRAM.
 *
 * The FRAM expects:
 * [2-byte memory address] [data bytes]
 *
 * We write at most 32 data bytes per I2C operation
 * to keep the temporary buffer small.
 */
int write_to_fram(
    const struct device *i2c_dev,
    uint16_t fram_address,
    const uint8_t *data,
    size_t length)
{
    if (i2c_dev == NULL || data == NULL || length == 0) {
        return -EINVAL;
    }

    if ((uint32_t)fram_address + length > FRAM_CAPACITY) {
        return -EINVAL;
    }

    uint8_t write_buffer[34];  // 2 address bytes + 32 data bytes

    size_t offset = 0;

    while (offset < length) {

        size_t chunk_size = length - offset;

        if (chunk_size > 32) {
            chunk_size = 32;
        }

        uint16_t current_address = fram_address + offset;

        // First two bytes: FRAM memory address.
        write_buffer[0] = (uint8_t)(current_address >> 8);
        write_buffer[1] = (uint8_t)(current_address & 0xFF);

        // Remaining bytes: data to store.
        memcpy(&write_buffer[2], &data[offset], chunk_size);

        int ret = i2c_write(
            i2c_dev,
            write_buffer,
            chunk_size + 2,
            FRAM_I2C_ADDR
        );

        if (ret != 0) {
            return ret;
        }

        offset += chunk_size;
    }

     printk("Write completed.\n");
    return 0;
}


/*
 * Read data from the FRAM.
 *
 * First, send the 16-bit memory address.
 * Then, read the requested number of bytes.
 */
int read_fram(
    const struct device *i2c_dev,
    uint16_t fram_address,
    uint8_t *data,
    size_t length)
{
    if (i2c_dev == NULL || data == NULL || length == 0) {
        return -EINVAL;
    }

    if ((uint32_t)fram_address + length > FRAM_CAPACITY) {
        return -EINVAL;
    }

    uint8_t address_buffer[2] = {
        (uint8_t)(fram_address >> 8),
        (uint8_t)(fram_address & 0xFF)
    };

    int ret = i2c_write_read(
        i2c_dev,
        FRAM_I2C_ADDR,
        address_buffer,
        sizeof(address_buffer),
        data,
        length
    );

    if (ret != 0) {
         printk("FAIL: FRAM read failed: %d\n", ret);
        return 0;
    }


    return ret;

}
```

## src/fram.h
```c
#ifndef FRAM_H
#define FRAM_H

#include <zephyr/device.h>
#include <stdint.h>
#include <stddef.h>

/* MB85RC256V parameters */
#define FRAM_I2C_ADDR  0x50
#define FRAM_CAPACITY  32768

/*
 * Write data to a specified FRAM memory address.
 *
 * i2c_dev:       I2C controller
 * fram_address:  Starting address inside FRAM
 * data:          Data to write
 * length:        Number of bytes to write
 *
 * Returns 0 on success, negative error code on failure.
 */



int write_to_fram(
    const struct device *i2c_dev,
    uint16_t fram_address,
    const uint8_t *data,
    size_t length
);

/*
 * Read data from a specified FRAM memory address.
 *
 * i2c_dev:       I2C controller
 * fram_address:  Starting address inside FRAM
 * data:          Buffer for the received data
 * length:        Number of bytes to read
 *
 * Returns 0 on success, negative error code on failure.
 */
int read_fram(
    const struct device *i2c_dev,
    uint16_t fram_address,
    uint8_t *data,
    size_t length
);

#endif
```

## src/i2C_listener.c
```c
#include "i2C_listener.h"
#include "fram.h"

#include <zephyr/drivers/i2c.h>
#include <errno.h>
#include <string.h>

/* ACF-I2C request codes */
#define I2C_CODE_CR1  0
#define I2C_CODE_CR3  2
#define I2C_CODE_CR4  3
#define I2C_CODE_CR5  4
#define I2C_CODE_CR7  6

/* ACF-I2C response codes */
#define I2C_CODE_TR1  8
#define I2C_CODE_TR2  9
#define I2C_CODE_TR3  10
#define I2C_CODE_TR5  12

#define I2C_EXCEPTION_NONE      0
#define I2C_EXCEPTION_SEQUENCE  13

#define FRAM_ADDR 0x50

#define BH1750_ADDR 0x23

/**
 * @brief Stores the state and data of an ongoing I2C transaction.
 *
 * Keeps track of the peripheral address, read/write direction,
 * transaction number, bus ID, buffered write data and read position.
 */
typedef struct {
    bool active;
    uint8_t address;
    bool read;

    uint8_t write_data[34];
    size_t write_length;

    uint16_t fram_read_address;
    size_t read_count;

    uint8_t transaction;
    uint16_t bus_id;
} i2c_transaction_t;

/** Holds the state of the currently active ACF-I2C transaction. */
static i2c_transaction_t current_transaction;

// For the BH1750
static uint8_t bh1750_cached_data[2];
static bool bh1750_data_valid = false;

//definition
static void create_brief_response(
    const Avtp_I2CBrief_t *request,
    Avtp_I2CBrief_t *response,
    uint8_t response_code,
    uint8_t exception_code,
    uint8_t response_data);

/**
 * @brief Creates a Full-format ACF-I2C response message.
 *
 * Sets the specified response code, exception code and response data.
 * Copies the transaction number, event information and I2C bus ID
 * from the original request to ensure that the response belongs
 * to the correct transaction.
 */
static void create_response(
    const Avtp_I2C_t *request,
    Avtp_I2C_t *response,
    uint8_t response_code,
    uint8_t exception_code,
    uint8_t response_data)
{
    Avtp_I2C_CreateAcfMessage(
        response,
        response_code,
        false,
        Avtp_I2C_GetTransactionNum(request),
        Avtp_I2C_GetEvt(request),
        exception_code,
        response_data
    );

    Avtp_I2C_SetI2CBusId(
        response,
        Avtp_I2C_GetI2CBusId(request)
    );
}


/**
 * @brief Processes one Full-format ACF-I2C request.
 *
 * Validates the incoming message and processes its I2C command.
 * Handles transaction initialization (CR1), write-data collection
 * (CR3), read-address handling (CR5), write execution (CR4),
 * and data reading (CR6 and CR7).
 *
 * Supports FRAM read/write operations and the BH1750 measurement
 * and read sequence. Generates the corresponding ACF-I2C response.
 */
static int process_full(
    const struct device *i2c_dev,
    const Avtp_I2C_t *request,
    size_t request_size,
    Avtp_I2C_t *response,
    size_t response_size)
{
    if (i2c_dev == NULL ||
        !device_is_ready(i2c_dev) ||
        response_size < sizeof(*response) ||
        !Avtp_I2C_IsValid(request, request_size)) {
        return -EINVAL;
    }

    uint8_t code = Avtp_I2C_GetI2CCode(request);
    uint8_t transaction = Avtp_I2C_GetTransactionNum(request);
    uint16_t bus_id = Avtp_I2C_GetI2CBusId(request);

    /* -------------------------------------------------
     * CR1: START and address the peripheral.
     * ------------------------------------------------- */
    if (code == I2C_CODE_CR1) {

        uint8_t address_data = Avtp_I2C_GetI2CData(request);
        uint8_t address = address_data >> 1;
        bool read = (address_data & 0x01U) != 0U;

        /* This first implementation supports FRAM writes only. */
        if (address != FRAM_ADDR && address != BH1750_ADDR) {
            create_response(
                request, response,
                I2C_CODE_TR1,
                I2C_EXCEPTION_NONE,
                0
            );
            return 0;
        }

        /* Start a new transaction. */
        memset(&current_transaction, 0, sizeof(current_transaction));

        current_transaction.active = true;
        current_transaction.address = address;
        current_transaction.read = read;
        current_transaction.transaction = transaction;
        current_transaction.bus_id = bus_id;
        current_transaction.read_count = 0;

        /* A BH1750 read is only allowed after a valid measurement. */
        if (address == BH1750_ADDR && read && !bh1750_data_valid) {
            current_transaction.active = false;

            create_response(
                request, response,
                I2C_CODE_TR1,
                I2C_EXCEPTION_SEQUENCE,
                0
            );

            return 0;
        }

        /* CR1 accepted: return TR2 (ACK). */
        create_response(
            request,
            response,
            I2C_CODE_TR2,
            I2C_EXCEPTION_NONE,
            0
        );

        return 0;
    }

    /* All following commands require an active transaction. */
    if (!current_transaction.active ||
        current_transaction.transaction != transaction ||
        current_transaction.bus_id != bus_id) {

        create_response(
            request, response,
            I2C_CODE_TR1,
            I2C_EXCEPTION_SEQUENCE,
            0
        );

        return 0;
    }

    /* -------------------------------------------------
     * CR3: Collect one write-data byte.
     * ------------------------------------------------- */
    if (code == I2C_CODE_CR3) {

        if (current_transaction.write_length >=
            sizeof(current_transaction.write_data)) {

            current_transaction.active = false;

            create_response(
                request, response,
                I2C_CODE_TR1,
                I2C_EXCEPTION_SEQUENCE,
                0
            );

            return 0;
        }

        current_transaction.write_data[
            current_transaction.write_length
        ] = Avtp_I2C_GetI2CData(request);

        current_transaction.write_length++;

        create_response(
            request, response,
            I2C_CODE_TR2,
            I2C_EXCEPTION_NONE,
            0
        );

        return 0;
    }
    /* -------------------------------------------------
     * CR5: End write phase and restart with read address.
     * ------------------------------------------------- */
    if (code == I2C_CODE_CR5) {

            /* This BH1750 test sequence does not use CR5. */
        if (current_transaction.address == BH1750_ADDR) {
            current_transaction.active = false;

            create_response(
                request,
                response,
                8,      /* TR1: NACK */
                0,
                0
            );
            return 0;
        }

        uint8_t address_data = Avtp_I2C_GetI2CData(request);
        uint8_t address = address_data >> 1;
        bool read = (address_data & 0x01U) != 0U;

        if (address != FRAM_ADDR &&
            address != BH1750_ADDR) {

            current_transaction.active = false;

            create_response(
                request, response,
                I2C_CODE_TR1,
                I2C_EXCEPTION_SEQUENCE,
                0
            );

            return 0;
        }

        current_transaction.fram_read_address =
            ((uint16_t)current_transaction.write_data[0] << 8) |
            current_transaction.write_data[1];

        current_transaction.read_count = 0;
        current_transaction.read = true;

        if (address == BH1750_ADDR && read) {
            if (!bh1750_data_valid) {
                current_transaction.active = false;

                create_response(
                    request, response,
                    I2C_CODE_TR1,
                    I2C_EXCEPTION_SEQUENCE,
                    0
                );

                return 0;
            }

            current_transaction.read = true;
            current_transaction.read_count = 0;
        }

        create_response(
            request, response,
            I2C_CODE_TR2,
            I2C_EXCEPTION_NONE,
            0
        );

        return 0;
    }

    /* -------------------------------------------------
     * CR4: STOP and execute the FRAM write.
     * ------------------------------------------------- */
    if (code == I2C_CODE_CR4) {

        if (current_transaction.address == BH1750_ADDR) {

            if (current_transaction.write_length != 1 ||
                current_transaction.write_data[0] != BH1750_ONETIME_HR) {

                current_transaction.active = false;

                create_response(
                    request, response,
                    I2C_CODE_TR1,
                    I2C_EXCEPTION_SEQUENCE,
                    0
                );

                return 0;
            }

            uint16_t raw_value;

            int ret = bh1750_read_raw(
                i2c_dev,
                &raw_value
            );

            current_transaction.active = false;

            if (ret != 0) {
                bh1750_data_valid = false;

                create_response(
                    request, response,
                    I2C_CODE_TR1,
                    I2C_EXCEPTION_NONE,
                    0
                );

                return ret;
            }

            bh1750_cached_data[0] =
                (uint8_t)(raw_value >> 8);

            bh1750_cached_data[1] =
                (uint8_t)(raw_value & 0xFF);

            bh1750_data_valid = true;

            if (Avtp_I2C_IsTrr(request)) {
                create_response(
                    request, response,
                    I2C_CODE_TR5,
                    I2C_EXCEPTION_NONE,
                    0
                );
            }

            return 0;
        }

        if (current_transaction.write_length < 3) {
            current_transaction.active = false;

            create_response(
                request, response,
                I2C_CODE_TR1,
                I2C_EXCEPTION_SEQUENCE,
                0
            );

            return 0;
        }

        uint16_t fram_address =
            ((uint16_t)current_transaction.write_data[0] << 8) |
            current_transaction.write_data[1];

        size_t data_length =
            current_transaction.write_length - 2;

        int ret = write_to_fram(
            i2c_dev,
            fram_address,
            &current_transaction.write_data[2],
            data_length
        );

        current_transaction.active = false;

        if (ret != 0) {
            create_response(
                request, response,
                I2C_CODE_TR1,
                I2C_EXCEPTION_NONE,
                0
            );
            return ret;
        }

        /*
         * TR5 is returned only when the requester asks
         * for STOP confirmation using TRR.
         */
        if (Avtp_I2C_IsTrr(request)) {
            create_response(
                request, response,
                I2C_CODE_TR5,
                I2C_EXCEPTION_NONE,
                0
            );
        }

        return 0;
    }

    /* CR6: Read one byte and continue. */
    if (code == 5) {

        if (current_transaction.address == BH1750_ADDR) {

            if (!current_transaction.read ||
                current_transaction.read_count >= 2) {
                return -EINVAL;
            }

            uint8_t read_data =
                bh1750_cached_data[current_transaction.read_count];

            current_transaction.read_count++;

            create_response(
                request, response,
                I2C_CODE_TR3,
                I2C_EXCEPTION_NONE,
                read_data
            );

            return 0;
        }

        if (!current_transaction.read) {
            current_transaction.active = false;

            create_response(
                request, response,
                I2C_CODE_TR1,
                I2C_EXCEPTION_SEQUENCE,
                0
            );
            return 0;
        }

        uint8_t read_data = 0;

        int ret = read_fram(
            i2c_dev,
            current_transaction.fram_read_address +
                current_transaction.read_count,
            &read_data,
            sizeof(read_data)
        );

        if (ret != 0) {
            current_transaction.active = false;

            create_response(
                request, response,
                I2C_CODE_TR1,
                I2C_EXCEPTION_NONE,
                0
            );

            return ret;
        }

        current_transaction.read_count++;

        create_response(
            request, response,
            I2C_CODE_TR3,
            I2C_EXCEPTION_NONE,
            read_data
        );

        return 0;
    }
    /* -------------------------------------------------
    * CR7: Read final byte, NACK and STOP.
    * ------------------------------------------------- */
    if (code == 6) {

        if (current_transaction.address == BH1750_ADDR) {

            if (!current_transaction.read ||
                current_transaction.read_count != 1) {
                current_transaction.active = false;
                return -EINVAL;
            }

            uint8_t read_data = bh1750_cached_data[1];

            current_transaction.read_count++;
            current_transaction.active = false;

            create_response(
                request, response,
                I2C_CODE_TR3,
                I2C_EXCEPTION_NONE,
                read_data
            );

            return 0;
        }
        if (!current_transaction.read) {
            current_transaction.active = false;

            create_response(
                request, response,
                I2C_CODE_TR1,
                I2C_EXCEPTION_SEQUENCE,
                0
            );

            return 0;
        }

        uint8_t read_data = 0;

        int ret = read_fram(
            i2c_dev,
            current_transaction.fram_read_address +
                current_transaction.read_count,
            &read_data,
            sizeof(read_data)
        );

        current_transaction.active = false;

        if (ret != 0) {
            create_response(
                request, response,
                I2C_CODE_TR1,
                I2C_EXCEPTION_NONE,
                0
            );

            return ret;
        }

        /* TR3 returns the byte read from the FRAM. */
        create_response(
            request, response,
            I2C_CODE_TR3,
            I2C_EXCEPTION_NONE,
            read_data
        );

        return 0;
    }
    /* Other commands are not implemented yet. */
    return -ENOTSUP;
}


/**
 * @brief Processes one Brief-format ACF-I2C request.
 *
 * Validates the incoming Brief message and processes its I2C command.
 * Handles transaction initialization (CR1), write-data collection
 * (CR3), read-address handling (CR5), FRAM write execution (CR4),
 * and final-byte reading (CR7).
 *
 * Supports FRAM read and write operations and generates the
 * corresponding Brief-format ACF-I2C response.
 */
static int process_brief(
    const struct device *i2c_dev,
    const Avtp_I2CBrief_t *request,
    size_t request_size,
    Avtp_I2CBrief_t *response,
    size_t response_size)
{
    if (i2c_dev == NULL ||
        !device_is_ready(i2c_dev) ||
        response_size < sizeof(*response) ||
        !Avtp_I2CBrief_IsValid(request, request_size)) {
        return -EINVAL;
    }

    uint8_t code = Avtp_I2CBrief_GetI2CCode(request);
    uint8_t transaction =
        Avtp_I2CBrief_GetTransactionNum(request);
    uint16_t bus_id =
        Avtp_I2CBrief_GetI2CBusId(request);

    /*
     * CR1: START and address the FRAM.
     */
    if (code == I2C_CODE_CR1) {

        uint8_t address_data =
            Avtp_I2CBrief_GetI2CData(request);

        uint8_t address = address_data >> 1;
        bool read = (address_data & 0x01U) != 0U;

        /* This implementation supports FRAM writes only. */
        if (address != FRAM_ADDR || read) {
            create_brief_response(
                request, response,
                I2C_CODE_TR1,
                I2C_EXCEPTION_NONE,
                0
            );
            return 0;
        }

        /* Start a new transaction. */
        memset(&current_transaction, 0,
               sizeof(current_transaction));

        current_transaction.active = true;
        current_transaction.address = address;
        current_transaction.read = false;
        current_transaction.transaction = transaction;
        current_transaction.bus_id = bus_id;

        create_brief_response(
            request, response,
            I2C_CODE_TR2,
            I2C_EXCEPTION_NONE,
            0
        );

        return 0;
    }

    /*
     * All following commands require an active transaction
     * with matching transaction number and bus ID.
     */
    if (!current_transaction.active ||
        current_transaction.transaction != transaction ||
        current_transaction.bus_id != bus_id) {

        create_brief_response(
            request, response,
            I2C_CODE_TR1,
            I2C_EXCEPTION_SEQUENCE,
            0
        );

        return 0;
    }

    /*
     * CR3: Collect one write-data byte.
     */
    if (code == I2C_CODE_CR3) {

        if (current_transaction.write_length >=
            sizeof(current_transaction.write_data)) {

            current_transaction.active = false;

            create_brief_response(
                request, response,
                I2C_CODE_TR1,
                I2C_EXCEPTION_SEQUENCE,
                0
            );

            return 0;
        }

        current_transaction.write_data[
            current_transaction.write_length
        ] = Avtp_I2CBrief_GetI2CData(request);

        current_transaction.write_length++;

        create_brief_response(
            request, response,
            I2C_CODE_TR2,
            I2C_EXCEPTION_NONE,
            0
        );

        return 0;
    }

    /* -------------------------------------------------
    * CR5: End write phase and restart with read address.
    * ------------------------------------------------- */
    if (code == I2C_CODE_CR5) {

        uint8_t address_data =
            Avtp_I2CBrief_GetI2CData(request);

        uint8_t address = address_data >> 1;
        bool read = (address_data & 0x01U) != 0U;

        /* Expect FRAM address 0x50 with the read bit set. */
        if (address != FRAM_ADDR ||
            !read ||
            current_transaction.write_length < 2) {

            current_transaction.active = false;

            create_brief_response(
                request, response,
                I2C_CODE_TR1,
                I2C_EXCEPTION_SEQUENCE,
                0
            );

            return 0;
        }

        current_transaction.read = true;

        create_brief_response(
            request, response,
            I2C_CODE_TR2,
            I2C_EXCEPTION_NONE,
            0
        );

        return 0;
    }

    /*
     * CR4: STOP and execute the physical FRAM write.
     */
    if (code == I2C_CODE_CR4) {

        if (current_transaction.write_length < 3) {
            current_transaction.active = false;

            create_brief_response(
                request, response,
                I2C_CODE_TR1,
                I2C_EXCEPTION_SEQUENCE,
                0
            );

            return 0;
        }

        uint16_t fram_address =
            ((uint16_t)current_transaction.write_data[0] << 8) |
            current_transaction.write_data[1];

        size_t data_length =
            current_transaction.write_length - 2;

        int ret = write_to_fram(
            i2c_dev,
            fram_address,
            &current_transaction.write_data[2],
            data_length
        );

        current_transaction.active = false;

        if (ret != 0) {
            create_brief_response(
                request, response,
                I2C_CODE_TR1,
                I2C_EXCEPTION_NONE,
                0
            );
            return ret;
        }

        /*
         * Send TR5 only when TRR requests STOP confirmation.
         */
        if (Avtp_I2CBrief_IsTrr(request)) {
            create_brief_response(
                request, response,
                I2C_CODE_TR5,
                I2C_EXCEPTION_NONE,
                0
            );
        }

        return 0;
    }

    /* -------------------------------------------------
    * CR7: Read final byte, NACK and STOP.
    * ------------------------------------------------- */
    if (code == I2C_CODE_CR7) {

        if (!current_transaction.read ||
            current_transaction.write_length < 2) {

            current_transaction.active = false;

            create_brief_response(
                request, response,
                I2C_CODE_TR1,
                I2C_EXCEPTION_SEQUENCE,
                0
            );

            return 0;
        }

        uint8_t memory_address[2] = {
            current_transaction.write_data[0],
            current_transaction.write_data[1]
        };

        uint8_t read_data = 0;

        int ret = i2c_write_read(
            i2c_dev,
            FRAM_ADDR,
            memory_address,
            sizeof(memory_address),
            &read_data,
            sizeof(read_data)
        );

        current_transaction.active = false;

        if (ret != 0) {

            create_brief_response(
                request, response,
                I2C_CODE_TR1,
                I2C_EXCEPTION_NONE,
                0
            );

            return ret;
        }

        /* TR3 returns the actual byte read from the FRAM. */
        create_brief_response(
            request, response,
            I2C_CODE_TR3,
            I2C_EXCEPTION_NONE,
            read_data
        );

        return 0;
    }
    return -ENOTSUP;
}


static void create_brief_response(
    const Avtp_I2CBrief_t *request,
    Avtp_I2CBrief_t *response,
    uint8_t response_code,
    uint8_t exception_code,
    uint8_t response_data)
{
    Avtp_I2CBrief_CreateAcfMessage(
        response,
        response_code,
        false,
        Avtp_I2CBrief_GetTransactionNum(request),
        Avtp_I2CBrief_GetEvt(request),
        exception_code,
        response_data
    );

    Avtp_I2CBrief_SetI2CBusId(
        response,
        Avtp_I2CBrief_GetI2CBusId(request)
    );
}


/**
 * @brief Dispatches an ACF-I2C request to the appropriate message processor.
 *
 * Checks the requested message format and forwards Full-format
 * messages to process_full() or Brief-format messages to process_brief().
 * Returns an error if the request or response pointer is invalid
 * or the message format is unsupported.
 */
int i2c_listener_process(
    const struct device *i2c_dev,
    i2c_message_format_t format,
    const void *request,
    size_t request_size,
    void *response,
    size_t response_size)
{
    if (request == NULL || response == NULL) {
        return -EINVAL;
    }

    switch (format) {
    case I2C_FORMAT_FULL:
        return process_full(
            i2c_dev,
            request,
            request_size,
            response,
            response_size
        );

    case I2C_FORMAT_BRIEF:
        return process_brief(
            i2c_dev,
            request,
            request_size,
            response,
            response_size
    );

    default:
        return -EINVAL;
    }
}
```

## src/i2C_listener.h
```c
#ifndef I2C_LISTENER_H
#define I2C_LISTENER_H

#include <stdint.h>
#include <stdbool.h>
#include <stddef.h>
#include <zephyr/device.h>
#include <zephyr/drivers/i2c.h>
#include <zephyr/kernel.h>
#include <errno.h>
#include <string.h>
#include "fram.h"
#include "bh1750.h"

#include "../Open1722/include/avtp/acf/I2C.h"
#include "../Open1722/include/avtp/acf/I2CBrief.h"

typedef enum {
    I2C_FORMAT_FULL,
    I2C_FORMAT_BRIEF
} i2c_message_format_t;

int i2c_listener_process(
    const struct device *i2c_dev,
    i2c_message_format_t format,
    const void *request,
    size_t request_size,
    void *response,
    size_t response_size
);
    
#endif
```

## src/i2C_test_listener.h
```c
#ifndef I2C_TEST_LISTENER_H
#define I2C_TEST_LISTENER_H

#include <zephyr/device.h>


/* Test creation and decoding of ACF-I2C messages */
void test_full_i2c_message(void);
void test_brief_i2c_message(void);

/* Test decoding of manually prepared raw messages */
void test_raw_brief_message(const struct device *i2c_dev);

/* Test the ACF-I2C listener */
void test_full_listener(const struct device *i2c_dev);
void test_brief_listener(const struct device *i2c_dev);


void test_full_fram_write(const struct device *i2c_dev);

void test_brief_fram_write(const struct device *i2c_dev);

void test_full_fram_read(const struct device *i2c_dev);

void test_full_fram_multibyte_read(const struct device *i2c_dev);

void test_brief_fram_read(const struct device *i2c_dev);

#endif /* I2C_TEST_LISTENER_H */
```
