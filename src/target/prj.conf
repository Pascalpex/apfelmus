## CMakeLists.txt
```
cmake_minimum_required(VERSION 3.20.0)

# Default network setup is DHCP (see prj.conf).

# I2C backend:
#   west build -b nucleo_f429zi

find_package(Zephyr REQUIRED HINTS $ENV{ZEPHYR_BASE})
project(i2c1722_target)

set(OPEN1722_DIR ${CMAKE_CURRENT_SOURCE_DIR}/../../Open1722 CACHE PATH "Open1722 checkout")

target_include_directories(app PRIVATE
    ${OPEN1722_DIR}/include
    ${CMAKE_CURRENT_SOURCE_DIR}/../common
)
target_sources(app PRIVATE
    src/main.c
    src/i2C_listener.c
    src/fram.c
    src/bh1750.c
    ${CMAKE_CURRENT_SOURCE_DIR}/../common/i2c1722.c
)
```

## prj.conf
```kconfig
# All options: https://docs.zephyrproject.org/latest/kconfig.html

# Networking: IPv4 + UDP sockets
CONFIG_NETWORKING=y
CONFIG_NET_IPV4=y
CONFIG_NET_IPV6=n
CONFIG_NET_SOCKETS=y
CONFIG_NET_UDP=y
# POSIX socket names (socket, bind, recvfrom, sendto)
CONFIG_POSIX_API=y

# Wait for an IPv4 address at boot
CONFIG_NET_CONFIG_SETTINGS=y
CONFIG_NET_CONFIG_NEED_IPV4=y

# --- DHCP ---
CONFIG_NET_DHCPV4=y

# --- static IP ---
#CONFIG_NET_CONFIG_MY_IPV4_ADDR="192.168.77.2"
#CONFIG_NET_CONFIG_MY_IPV4_NETMASK="255.255.255.0"

# Reachable as apfelmus.local
CONFIG_NET_HOSTNAME_ENABLE=y
CONFIG_NET_HOSTNAME="apfelmus"
CONFIG_MDNS_RESPONDER=y

CONFIG_LOG=y

# On-board LED
CONFIG_GPIO=y

CONFIG_I2C=y
```

## boards/nucleo_f429zi.overlay
```dts
/*
 * I2C bus the ACF_I2C requests are executed on (DT_ALIAS(i2c1722_bus) in main.c).
 * Real hardware: i2c1 = PB8 SCL / PB9 SDA (Arduino D15 / D14).
 * With I2C1722_EMUL=ON, emul/emul.overlay points this alias to the emulated bus instead.
 */
/ {
	aliases {
		i2c1722-bus = &i2c1;
	};
};
```

## src/main.c
```c
/* Target Controller (board): receives ACF_I2C messages over IEEE 1722 / UDP. */
#include <stdio.h>
#include <string.h>
#include <errno.h>

#include <zephyr/kernel.h>
#include <zephyr/logging/log.h>
#include <zephyr/drivers/i2c.h>
#include <zephyr/posix/arpa/inet.h>
#include <zephyr/posix/sys/socket.h>
#include <zephyr/posix/unistd.h>
#include "i2C_listener.h"

#include "i2c1722.h"

LOG_MODULE_REGISTER(i2c1722_target, LOG_LEVEL_INF);

#define MAX_I2C_MSGS 16

/* I2C bus the requests are executed on*/
static const struct device *i2c_bus = DEVICE_DT_GET(DT_ALIAS(i2c1722_bus));

/* static: keeps the buffers off the main stack */
static uint8_t rx_buf[I2C1722_PDU_SIZE(MAX_I2C_MSGS)];
static Avtp_I2C_t msgs[MAX_I2C_MSGS];
static uint8_t tx_buf[I2C1722_PDU_SIZE(MAX_I2C_MSGS)];
static Avtp_I2C_t rsp_msgs[MAX_I2C_MSGS];
static uint32_t tx_seq; /* sequence number of the target's own stream */

/* from create_listener_socket_udp() in Open1722 examples/acf-can/zephyr */
static int create_listener_socket_udp(uint32_t udp_port)
{

    int fd, res;
    struct sockaddr_in sk_addr;

    // create a UDP socket
    fd = socket(AF_INET, SOCK_DGRAM, IPPROTO_UDP);
    if (fd < 0)
    {
        perror("Failed to open socket");
        return -1;
    }

    // Initialize the socket
    memset((char *)&sk_addr, 0, sizeof(sk_addr));
    sk_addr.sin_family = AF_INET;
    sk_addr.sin_port = htons(udp_port);
    sk_addr.sin_addr.s_addr = htonl(INADDR_ANY);

    res = bind(fd, (struct sockaddr *)&sk_addr, sizeof(sk_addr));
    if (res < 0)
    {
        perror("Couldn't bind() to port");
        close(fd);
        return -1;
    }

    return fd;
}



static void execute_i2c(
    const Avtp_I2C_t *req,
    Avtp_I2C_t *rsp,
    int n)
{
    // process each request message and generate a response message
    for (int i = 0; i < n; i++) {

        // store the response in rsp[i]
        int ret = i2c_listener_process(
            i2c_bus,
            I2C_FORMAT_FULL,
            &req[i],
            sizeof(req[i]),
            &rsp[i],
            sizeof(rsp[i])
        );

        if (ret < 0) {
            LOG_ERR("I2C request %d failed: %d", i, ret);
        }
    }
}

int main(void)
{
    LOG_INF("i2c1722 target");

    int fd = create_listener_socket_udp(I2C1722_UDP_PORT);
    if (fd < 0)
    {
        return 0;
    }
    LOG_INF("Listening for ACF_I2C on UDP port %d", I2C1722_UDP_PORT);

    for (;;)
    {
        struct sockaddr_in src;
        socklen_t src_len = sizeof(src);
        ssize_t len = recvfrom(fd, rx_buf, sizeof(rx_buf), 0, (struct sockaddr *)&src, &src_len);
        if (len < 0)
        {
            LOG_ERR("recvfrom() failed: %d", errno);
            continue;
        }

        uint32_t seq;
        int n = avtp_to_i2c(rx_buf, (size_t)len, 1, I2C1722_CONTROLLER_STREAM_ID, msgs,
                            MAX_I2C_MSGS, &seq);
        if (n < 0)
        {
            LOG_WRN("Dropped %d-byte frame (not a valid ACF_I2C frame of our stream)", (int)len);
            continue;
        }

        char ip[INET_ADDRSTRLEN];
        inet_ntop(AF_INET, &src.sin_addr, ip, sizeof(ip));
        LOG_INF("Frame seq=%u from %s: %d ACF_I2C message(s)", seq, ip, n);

        for (int i = 0; i < n; i++)
        {
            const Avtp_I2C_t *m = &msgs[i];
            LOG_INF("  [%d] bus=%u code=0x%x trr=%d txn=%u evt=0x%x exc=0x%x data=0x%02x", i,
                    Avtp_I2C_GetI2CBusId(m), Avtp_I2C_GetI2CCode(m), Avtp_I2C_IsTrr(m),
                    Avtp_I2C_GetTransactionNum(m), Avtp_I2C_GetEvt(m),
                    Avtp_I2C_GetExceptionCode(m), Avtp_I2C_GetI2CData(m));
        }

        /* Run the requests on the I2C bus, one response message per request message */
        execute_i2c(msgs, rsp_msgs, n);

        int rsp_len = i2c_to_avtp(tx_buf, sizeof(tx_buf), 1, AVTPDU_VERSION_0,
                                  I2C1722_TARGET_STREAM_ID, tx_seq++, rsp_msgs, (uint8_t)n);
        if (rsp_len < 0 ||
            sendto(fd, tx_buf, (size_t)rsp_len, 0, (struct sockaddr *)&src, src_len) < 0)
        {
            LOG_ERR("Sending response failed: %d", errno);
            continue;
        }
        LOG_INF("Response seq=%u sent to %s: %d ACF_I2C message(s)", tx_seq - 1, ip, n);
    }
    return 0;
}
```

## src/bh1750.h
```c
#ifndef BH1750_H
#define BH1750_H

#include <zephyr/device.h>
#include <stdint.h>

#define BH1750_I2C_ADDR       0x23
#define BH1750_ONETIME_HR     0x20

/*
 * Perform one light measurement.
 *
 * i2c_dev: I2C controller
 * lux_x100: output value in hundredths of lux
 *
 * Example:
 * 12545 means 125.45 lux.
 *
 * Returns 0 on success, negative error code on failure.
 */
int bh1750_read_raw(
    const struct device *i2c_dev,
    uint16_t *raw_value
);

int bh1750_read_lux(
    const struct device *i2c_dev,
    uint32_t *lux_x100
);

#endif
```

## src/fram.c
```c
#include "fram.h"

#include <zephyr/drivers/i2c.h>
#include <errno.h>
#include <string.h>

/*
 * Write data to the FRAM.
 *
 * The FRAM expects:
 * [2-byte memory address] [data bytes]
 *
 * We write at most 32 data bytes per I2C operation
 * to keep the temporary buffer small.
 */
int write_to_fram(
    const struct device *i2c_dev,
    uint16_t fram_address,
    const uint8_t *data,
    size_t length)
{
    if (i2c_dev == NULL || data == NULL || length == 0) {
        return -EINVAL;
    }

    if ((uint32_t)fram_address + length > FRAM_CAPACITY) {
        return -EINVAL;
    }

    uint8_t write_buffer[34];  // 2 address bytes + 32 data bytes

    size_t offset = 0;

    while (offset < length) {

        size_t chunk_size = length - offset;

        if (chunk_size > 32) {
            chunk_size = 32;
        }

        uint16_t current_address = fram_address + offset;

        // First two bytes: FRAM memory address.
        write_buffer[0] = (uint8_t)(current_address >> 8);
        write_buffer[1] = (uint8_t)(current_address & 0xFF);

        // Remaining bytes: data to store.
        memcpy(&write_buffer[2], &data[offset], chunk_size);

        int ret = i2c_write(
            i2c_dev,
            write_buffer,
            chunk_size + 2,
            FRAM_I2C_ADDR
        );

        if (ret != 0) {
            printk("FAIL: FRAM write failed: %d\n", ret);
            return ret;
        }

        offset += chunk_size;
    }

     printk("Write completed.\n");
    return 0;
}


/*
 * Read data from the FRAM.
 *
 * First, send the 16-bit memory address.
 * Then, read the requested number of bytes.
 */
int read_fram(
    const struct device *i2c_dev,
    uint16_t fram_address,
    uint8_t *data,
    size_t length)
{
    if (i2c_dev == NULL || data == NULL || length == 0) {
        return -EINVAL;
    }

    if ((uint32_t)fram_address + length > FRAM_CAPACITY) {
        return -EINVAL;
    }

    uint8_t address_buffer[2] = {
        (uint8_t)(fram_address >> 8),
        (uint8_t)(fram_address & 0xFF)
    };

    int ret = i2c_write_read(
        i2c_dev,
        FRAM_I2C_ADDR,
        address_buffer,
        sizeof(address_buffer),
        data,
        length
    );

    if (ret != 0) {
         printk("FAIL: FRAM read failed: %d\n", ret);
        return ret;
    }


    return ret;

}
```

## src/fram.h
```c
#ifndef FRAM_H
#define FRAM_H

#include <zephyr/device.h>
#include <stdint.h>
#include <stddef.h>
#include <zephyr/sys/printk.h>

/* MB85RC256V parameters */
#define FRAM_I2C_ADDR  0x50
#define FRAM_CAPACITY  32768

/*
 * Write data to a specified FRAM memory address.
 *
 * i2c_dev:       I2C controller
 * fram_address:  Starting address inside FRAM
 * data:          Data to write
 * length:        Number of bytes to write
 *
 * Returns 0 on success, negative error code on failure.
 */



int write_to_fram(
    const struct device *i2c_dev,
    uint16_t fram_address,
    const uint8_t *data,
    size_t length
);

/*
 * Read data from a specified FRAM memory address.
 *
 * i2c_dev:       I2C controller
 * fram_address:  Starting address inside FRAM
 * data:          Buffer for the received data
 * length:        Number of bytes to read
 *
 * Returns 0 on success, negative error code on failure.
 */
int read_fram(
    const struct device *i2c_dev,
    uint16_t fram_address,
    uint8_t *data,
    size_t length
);

#endif
```

## src/i2C_listener.h
```c
#ifndef I2C_LISTENER_H
#define I2C_LISTENER_H

#include <stdint.h>
#include <stdbool.h>
#include <stddef.h>
#include <zephyr/device.h>
#include <zephyr/drivers/i2c.h>
#include <zephyr/kernel.h>
#include <errno.h>
#include <string.h>
#include "fram.h"
#include "bh1750.h"

#include <avtp/acf/I2C.h>
#include <avtp/acf/I2CBrief.h>

typedef enum {
    I2C_FORMAT_FULL,
    I2C_FORMAT_BRIEF
} i2c_message_format_t;

int i2c_listener_process(
    const struct device *i2c_dev,
    i2c_message_format_t format,
    const void *request,
    size_t request_size,
    void *response,
    size_t response_size
);
    
#endif
```

## src/i2C_test_listener.h
```c
#ifndef I2C_TEST_LISTENER_H
#define I2C_TEST_LISTENER_H

#include <zephyr/device.h>


/* Test creation and decoding of ACF-I2C messages */
void test_full_i2c_message(void);
void test_brief_i2c_message(void);

/* Test decoding of manually prepared raw messages */
void test_raw_brief_message(const struct device *i2c_dev);

/* Test the ACF-I2C listener */
void test_full_listener(const struct device *i2c_dev);
void test_brief_listener(const struct device *i2c_dev);


void test_full_fram_write(const struct device *i2c_dev);

void test_brief_fram_write(const struct device *i2c_dev);

void test_full_fram_read(const struct device *i2c_dev);

void test_full_fram_multibyte_read(const struct device *i2c_dev);

void test_brief_fram_read(const struct device *i2c_dev);

void test_full_bh1750_read(const struct device *i2c_dev);

#endif /* I2C_TEST_LISTENER_H */
```
