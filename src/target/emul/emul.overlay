/*
 * Emulated I2C bus with an emulated ADT7420 temperature sensor at 0x48.
 * Software only, no real I2C signals. Applied when building with I2C1722_EMUL=ON.
 */
/ {
	aliases {
		i2c1722-bus = &i2c_emul; /* overrides &i2c1 from boards/nucleo_f429zi.overlay */
	};

	i2c_emul: i2c@100 {
		compatible = "zephyr,i2c-emul-controller";
		reg = <0x100 4>; /* only a devicetree identifier, no real hardware */
		clock-frequency = <I2C_BITRATE_STANDARD>;
		#address-cells = <1>;
		#size-cells = <0>;
		status = "okay";

		adt7420: adt7420@48 {
			compatible = "adi,adt7420";
			reg = <0x48>;
		};
	};
};
